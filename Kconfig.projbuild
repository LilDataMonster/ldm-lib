## Kconfig.projbuild
```kconfig
menu "LDM Library"

    menu "WiFi STA Configuration"

        config WIFI_STA_SSID
            string "WiFi STA SSID"
            default "WIFI_STA_SSID"
            help
                SSID (network name) for the network to connect to.

        config WIFI_STA_PASSWORD
            string "WiFi STA Password"
            default "WIFI_STA_PASSWORD"
            help
                WiFi password (WPA or WPA2) for the network to connect to.

        config WIFI_STA_HOSTNAME
            string "STA Hostname"
            default "lildatamonster"
            help
                Set the hostname for the STA.

    endmenu

    menu "WiFi AP Configuration"

        config WIFI_AP_SSID
            string "WiFi AP SSID"
            default "WIFI_AP_SSID"
            help
                SSID (network name) for the device to host as.

        config WIFI_AP_PASSWORD
            string "WiFi AP Password"
            default "WIFI_AP_PASSWORD"
            help
                WiFi password (WPA or WPA2) for the device to host as.

        choice WIFI_AP_AUTH_MODE
            prompt "WiFi AP Auth Mode"
            default WIFI_AUTH_WPA_WPA2_PSK
            help
                WiFi authmode for the device.

            config WIFI_AUTH_OPEN
                bool "OPEN"
            config WIFI_AUTH_WEP
                bool "WEP"
            config WIFI_AUTH_WPA_PSK
                bool "WPA_PSK"
            config WIFI_AUTH_WPA2_PSK
                bool "WPA2_PSK"
            config WIFI_AUTH_WPA_WPA2_PSK
                bool "WPA_WPA2_PSK"
            config WIFI_AUTH_WPA2_ENTERPRISE
                bool "WPA2_ENTERPRISE"
            config WIFI_AUTH_WPA3_PSK
                bool "WPA3_PSK"
            config WIFI_AUTH_WPA2_WPA3_PSK
                bool "WPA2_WPA3_PSK"
            config WIFI_AUTH_WAPI_PSK
                bool "WAPI_PSK"
        endchoice

        config WIFI_AP_HIDDEN
            bool "Set Hidden SSID"
            default n
            help
                Set the SSID to be hidden.

        config WIFI_AP_MAX_CONNECTIONS
            int "Max Number of Connections"
            range 1 10
            default 4
            help
                Set the maximum number of stations allowed to connect (max: 10).

        config WIFI_AP_CHANNEL
            int "WiFi AP 2.4GHz Channel"
            range 1 13
            default 8
            help
                Set the channel for the AP.

        config WIFI_AP_HOSTNAME
            string "AP Hostname"
            default "lildatamonster"
            help
                Set the hostname for the AP.

        config WIFI_AP_IPV4
            string "Static AP IPv4 Address"
            default "192.168.0.2"
            help
                Set a static IPv4 Address for the AP.

        config WIFI_AP_GATEWAY
            string "Static AP Gateway Address"
            default "192.168.0.1"
            help
                Set a static Gateway for the AP.

        config WIFI_AP_NETMASK
            string "Static AP Netmask"
            default "255.255.0.0"
            help
                Set a static Netmask for the AP.

    endmenu

    choice POWER_SAVE_MODE
        prompt "Power Save Mode"
        default POWER_SAVE_MIN_MODEM
        help
            Power save mode for the esp32 to use. Modem sleep mode includes minimum and maximum power save modes.
            In minimum power save mode, station wakes up every DTIM to receive beacon. Broadcast data will not be
            lost because it is transmitted after DTIM. However, it can not save much more power if DTIM is short
            for DTIM is determined by AP.
            In maximum power save mode, station wakes up every listen interval to receive beacon. Broadcast data
            may be lost because station may be in sleep state at DTIM time. If listen interval is longer, more power
            is saved but broadcast data is more easy to lose.

        config POWER_SAVE_NONE
            bool "none"
        config POWER_SAVE_MIN_MODEM
            bool "minimum modem"
        config POWER_SAVE_MAX_MODEM
            bool "maximum modem"
    endchoice

    choice MAX_CPU_FREQ
        prompt "Maximum CPU Frequency"
        default MAX_CPU_FREQ_80
        help
            Maximum CPU frequency to use for dynamic frequency scaling.

        config MAX_CPU_FREQ_80
            bool "80 MHz"
        config MAX_CPU_FREQ_160
            bool "160 MHz"
        config MAX_CPU_FREQ_240
            bool "240 MHz"
    endchoice

    config MAX_CPU_FREQ_MHZ
        int
        default 80 if MAX_CPU_FREQ_80
        default 160 if MAX_CPU_FREQ_160
        default 240 if MAX_CPU_FREQ_240


    choice MIN_CPU_FREQ
        prompt "Minimum CPU Frequency"
        default MIN_CPU_FREQ_10M
        help
            Minimum CPU frequency to use for dynamic frequency scaling.
            Should be set to XTAL frequency or XTAL frequency divided by integer.

        config MIN_CPU_FREQ_40M
            bool "40 MHz (use with 40MHz XTAL)"
            depends on IDF_TARGET_ESP32S2 || ESP32_XTAL_FREQ_40 || ESP32_XTAL_FREQ_AUTO
        config MIN_CPU_FREQ_20M
            bool "20 MHz (use with 40MHz XTAL)"
            depends on IDF_TARGET_ESP32S2 || ESP32_XTAL_FREQ_40 || ESP32_XTAL_FREQ_AUTO
        config MIN_CPU_FREQ_10M
            bool "10 MHz (use with 40MHz XTAL)"
            depends on IDF_TARGET_ESP32S2 || ESP32_XTAL_FREQ_40 || ESP32_XTAL_FREQ_AUTO
        config MIN_CPU_FREQ_26M
            bool "26 MHz (use with 26MHz XTAL)"
            depends on ESP32_XTAL_FREQ_26 || ESP32_XTAL_FREQ_AUTO
        config MIN_CPU_FREQ_13M
            bool "13 MHz (use with 26MHz XTAL)"
            depends on ESP32_XTAL_FREQ_26 || ESP32_XTAL_FREQ_AUTO
    endchoice

    config MIN_CPU_FREQ_MHZ
        int
        default 40 if MIN_CPU_FREQ_40M
        default 20 if MIN_CPU_FREQ_20M
        default 10 if MIN_CPU_FREQ_10M
        default 26 if MIN_CPU_FREQ_26M
        default 13 if MIN_CPU_FREQ_13M

    menu "OTA Updates"

        config OTA_ENABLED
            bool "Enable OTA Updates"
            default n
            help
                Enables OTA Updates.

        config FIRMWARE_UPGRADE_ENDPOINT
            depends on OTA_ENABLED
            string "Firmware Upgrade URL Endpoint"
            default "https://ota.lildata.monster:5000/firmware/hello-world.bin"
            help
                URL of server which hosts the firmware image.

        config SKIP_COMMON_NAME_CHECK
            depends on OTA_ENABLED
            bool "Skip Server Certificate CN Fieldcheck"
            default n
            help
                Skip the validation of OTA server certificate CN field.
    endmenu

endmenu
```
